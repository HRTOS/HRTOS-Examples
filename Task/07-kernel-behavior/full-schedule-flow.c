#include "hrtos.h"

/* =========================================================
 * LED（调度可视化）
 * ========================================================= */
sbit LED_A = P1^0;
sbit LED_B = P1^1;
sbit LED_C = P1^2;

/* =========================================================
 * 任务ID
 * ========================================================= */
#define T_A 1
#define T_B 2
#define T_C 3

/* =========================================================
 * TASK A（高频调度观察）
 * ========================================================= */
static void task_a(void)
{
    while(1)
    {
        LED_A = ~LED_A;
        os_delay(5);
    }
}

/* =========================================================
 * TASK B（中频）
 * ========================================================= */
static void task_b(void)
{
    while(1)
    {
        LED_B = ~LED_B;
        os_delay(20);
    }
}

/* =========================================================
 * TASK C（低频 + 长占用）
 * ========================================================= */
static void task_c(void)
{
    volatile u16 i;

    while(1)
    {
        LED_C = ~LED_C;

        /* 模拟CPU占用 */
        for(i = 0; i < 3000; i++);

        os_delay(50);
    }
}

/* =========================================================
 * 系统入口
 * ========================================================= */
void hrtos_main(void)
{
    LED_A = 0;
    LED_B = 0;
    LED_C = 0;

    /* =========================
     * 创建任务（关键：不同优先级 + 行为）
     * ========================= */
    os_task_create((unsigned int)task_a, 1, 2, 5);
    os_task_create((unsigned int)task_b, 2, 3, 5);
    os_task_create((unsigned int)task_c, 3, 4, 5);

}