#include "hrtos.h"

/* =========================================================
 * LED时间可视化
 * ========================================================= */
sbit LED_TICK = P1^0;
sbit LED_1S   = P1^1;
sbit LED_RUN  = P1^2;

/* =========================================================
 * 系统tick计数
 * ========================================================= */
static volatile u32 g_tick_count = 0;

/* =========================================================
 * Timer1中断服务函数（系统tick源）
 * ========================================================= */
void timer1_isr(void)
{
    /* tick递增 */
    g_tick_count++;

    /* LED翻转（tick可视化） */
    LED_TICK = ~LED_TICK;

    /* 退出中断（触发调度） */
    os_interrupt_exit();
}

/* =========================================================
 * uptime（ms）
 * ========================================================= */
u32 os_uptime_ms(void)
{
    return g_tick_count;
}

/* =========================================================
 * busy delay（阻塞延时）
 * ========================================================= */
void task_delay_ms(u16 ms)
{
    u32 start = g_tick_count;

    while ((g_tick_count - start) < ms);
}

/* =========================================================
 * LED演示任务
 * ========================================================= */
void task_time_led_demo(void)
{
    u32 last_1s = 0;
    u32 last_100ms = 0;

    while (1)
    {
        u32 now = os_uptime_ms();

        /* 100ms翻转 */
        if (now - last_100ms >= 1)
        {
            last_100ms = now;
            LED_RUN = ~LED_RUN;
        }

        /* 1s翻转 */
        if (now - last_1s >= 10)
        {
            last_1s = now;
            LED_1S = ~LED_1S;
        }

        task_delay_ms(1);
    }
}

/* =========================================================
 * 系统入口
 * ========================================================= */
void hrtos_main(void)
{
    /* LED初始化 */
    LED_TICK = 0;
    LED_1S   = 0;
    LED_RUN  = 0;

    /* tick清零 */
    g_tick_count = 0;

    /* =========================
     * Timer1配置
     * ========================= */
    TMOD &= 0x0F;
    TMOD |= 0x10;   /* Timer1 mode1 */

    TH1 = 0xFC;
    TL1 = 0x66;

    ET1 = 1;
    EA  = 1;
    TR1 = 1;

    /* =========================
     * 注册tick任务（ISR）
     * ========================= */
    os_task_create((unsigned int)timer1_isr, 0, 9, 0);

    /* =========================
     * LED任务
     * ========================= */
    os_task_create((unsigned int)task_time_led_demo, 1, 2, 5);
}